// 2023/03/30 10:55:47 (c) Aleksandr Shevchenko e-mail : Sasha7b9@tut.by
#include "defines.h"
#include "Hardware/Modules/SSD1306/SSD1306.h"
#include "Hardware/HAL/HAL.h"
#include <cstring>
#include <cstdlib>


static const uint16 Font7x10 [] = {
0x0000, 0x0000, 0x0000, 0x0000, 0x0000, 0x0000, 0x0000, 0x0000, 0x0000, 0x0000,  // sp
0x1000, 0x1000, 0x1000, 0x1000, 0x1000, 0x1000, 0x0000, 0x1000, 0x0000, 0x0000,  // !
0x2800, 0x2800, 0x2800, 0x0000, 0x0000, 0x0000, 0x0000, 0x0000, 0x0000, 0x0000,  // "
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0x0000, 0x0000, 0x0000, 0x7400, 0x4C00, 0x0000, 0x0000, 0x0000, 0x0000, 0x0000,  // ~
};

FontDef Font_7x10 = {7,10,Font7x10};

namespace SSD1306
{
#define SSD1306_ADDR              0x3C

#define SSD1306_COMMAND_STREAM    0x80  // Continuation bit=1, D/C=0; 1000 0000
#define SSD1306_COMMAND           0x00  // Continuation bit=0, D/C=0; 0000 0000
#define SSD1306_DATA_STREAM       0xC0  // Continuation bit=1, D/C=1; 1100 0000
#define SSD1306_DATA              0x40  // Continuation bit=0, D/C=1; 0100 0000

#define CACHE_SIZE_MEM  1024
static uint8 video_memory[CACHE_SIZE_MEM];
static uint8 cursorX = 0, cursorY = 0;

    static void SendCommand(uint8);

    static void SendData(uint8* buffer, uint8 buff_size);
}

void SSD1306::SendCommand(uint8 command)
{
	  HAL_I2C::Write(SSD1306_COMMAND, &command, 1);
}

void SSD1306::SendData(uint8* buffer, uint8 buff_size)
{
	  HAL_I2C::Write(SSD1306_DATA, buffer, buff_size);	
}

void SSD1306::Init()
{
    SendCommand(0xAE); // Set display OFF
 
    SendCommand(0xD4); // Set Display Clock Divide Ratio / OSC Frequency
    SendCommand(0x80); // Display Clock Divide Ratio / OSC Frequency 
 
    SendCommand(0xA8); // Set Multiplex Ratio
    SendCommand(0x3F); // Multiplex Ratio for 128x64 (64-1)
 
    SendCommand(0xD3); // Set Display Offset
    SendCommand(0x00); // Display Offset
 
    SendCommand(0x40); // Set Display Start Line
 
    SendCommand(0x8D); // Set Charge Pump
    SendCommand(0x14); // Charge Pump (0x10 External, 0x14 Internal DC/DC)
 
    SendCommand(0xA1); // Set Segment Re-Map
    SendCommand(0xC8); // Set Com Output Scan Direction
 
    SendCommand(0xDA); // Set COM Hardware Configuration
    SendCommand(0x12); // COM Hardware Configuration
 
    SendCommand(0x81); // Set Contrast
    SendCommand(0xCF); // Contrast
 
    SendCommand(0xD9); // Set Pre-Charge Period
    SendCommand(0xF1); // Set Pre-Charge Period (0x22 External, 0xF1 Internal)
 
    SendCommand(0xDB); // Set VCOMH Deselect Level
    SendCommand(0x40); // VCOMH Deselect Level
 
    SendCommand(0xA4); // Set all pixels OFF
    SendCommand(0xA6); // Set display not inverted
    SendCommand(0xAF); // Set display On
}


void SSD1306::UpdateScreen()
{
    // Write data to each page of RAM. Number of pages
    // depends on the screen height:
    //
    //  * 32px   ==  4 pages
    //  * 64px   ==  8 pages
    //  * 128px  ==  16 pages
    for(uint8 i = 0; i < SSD1306_HEIGHT/8; i++)
	  {
        SendCommand(0xB0 + i); // Set the current RAM page address.
        SendCommand(0x00 + SSD1306_X_OFFSET_LOWER);
        SendCommand(0x10 + SSD1306_X_OFFSET_UPPER);
        SendData(&video_memory[SSD1306_WIDTH*i],SSD1306_WIDTH);
    };
}   


void SSD1306::Fill()
{
    std::memset(video_memory, 0x00, CACHE_SIZE_MEM);
    
    SSD1306::UpdateScreen();
}

/*
 * Draw one pixel in the screenbuffer
 * X => X Coordinate
 * Y => Y Coordinate
 * color => Pixel color
 */
void SSD1306::DrawPixel(uint8 x, uint8 y, uint8 color)
{
	  if(x >= SSD1306_WIDTH || y >= SSD1306_HEIGHT)
		{
        //Don't write outside the buffer
        return;
    };
		
		if(color)
		{
        video_memory[x + (y / 8) * SSD1306_WIDTH] |= 1 << (y % 8);
    }
		else
		{ 
        video_memory[x + (y / 8) * SSD1306_WIDTH] &= ~(1 << (y % 8));
    }
}

/* Draw a bitmap */
void SSD1306::DrawBitmap(uint8 x, uint8 y, const unsigned char* bitmap, uint8 w, uint8 h)
{
    int16 byteWidth = (w + 7) / 8; // Bitmap scanline pad = whole byte
    uint8 byte = 0;

    for(uint8 j = 0; j < h; j++, y++)
	  {
        for(uint8 i = 0; i < w; i++)
			  {
            if(i & 7)
						{
                byte <<= 1;
            }
						else
						{
                byte = (*(const unsigned char *)(&bitmap[j * byteWidth + i / 8]));
            };

            if(byte & 0x80)
						{
							SSD1306::DrawPixel(x + i, y, 1);
            };
        };
    };
}

/* Position the cursor */
void SSD1306::SetCursor(uint8 x, uint8 y)
{
    cursorX = x;
    cursorY = y;
}

/* Write full string to screenbuffer */
char SSD1306::WriteString(char* str, FontDef Font)
{
    while(*str)
		{
			if(SSD1306::WriteChar(*str, Font) != *str)
				{
            // Char could not be written
            return *str;
        };
        str++;
    };
    
    // Everything ok
    return *str;
}

/*
 * Draw 1 char to the screen buffer
 * ch       => char om weg te schrijven
 * Font     => Font waarmee we gaan schrijven
 */
char SSD1306::WriteChar(char ch, FontDef Font)
{
    uint i, b, j;
    
    //Check if character is valid
    if(ch < 32 || ch > 126)
        return 0;
    
    //Check remaining space on current line
    if(SSD1306_WIDTH < (cursorX + Font.FontWidth) || SSD1306_HEIGHT < (cursorY + Font.FontHeight))
    {
        // Not enough space on current line
        return 0;
    };
    
    //Use the font to write
    for(i = 0; i < Font.FontHeight; i++)
		{
        b = Font.data[(ch - 32) * Font.FontHeight + i];
        for(j = 0; j < Font.FontWidth; j++)
			  {
            if((b << j) & 0x8000)
						{
							  SSD1306::DrawPixel(cursorX + j, (cursorY + i), 1);
            }
						else
						{
							  SSD1306::DrawPixel(cursorX + j, (cursorY + i), 0);
            };
        };
    };
    
    // The current space is now taken
    cursorX += Font.FontWidth;
    
    // Return written char for validation
    return ch;
}
